# JTAG register map
Vendor: litex
Registers are 32-bit, read-write, reset 0x0 unless marked. A register's access mark holds for its fields unless they carry their own. Offsets are from the block's base; lines under a group give offsets from that group; [hi:lo] are bit positions; {n}, {i} and the like mark numbered series; 'fields as' and 'values as' point back to an identical list; <NAME> marks a mode.

## Memory map
0xF0000000 CTRL size 0xC
0xF0002000 IDENTIFIER_MEM size 0x4
0xF0003000 UART_PHY size 0x4
0xF0004000 UART size 0x20
0xF0005000 TIMER0 size 0x20
0xF0006000 REBOOT size 0x8
0xF0007000 CRG size 0x20
0xF0008000 INFO size 0x64
0xF0009000 SRAM_EXT size 0x8
0xF000A000 MEMLCD size 0x18
0xF000B000 COM size 0x1C
0xF000C000 I2C size 0x24
0xF000D000 BTEVENTS size 0xC
0xF000E000 MESSIBLE size 0xC
0xF000F000 TICKTIMER size 0xC
0xF0010000 POWER size 0x14
0xF0011000 SPINOR size 0x2C
0xF0012000 KEYBOARD size 0x34
0xF0013000 GPIO size 0x20
0xF0014000 SEED size 0x8
0xF0015000 ROMTEST size 0x8
0xF0016000 AUDIO size 0x24
0xF0017000 TRNG_OSC size 0xC
0xF0018000 AES size 0x5C
0xF0019000 SHA2 size 0x68
0xF001A000 SHA512 size 0x60
0xF001B000 ENGINE size 0x24
0xF001C000 JTAG size 0x8

## Interrupts
0 uart (UART)
1 timer0 (TIMER0)
2 i2c (I2C)
3 btevents (BTEVENTS)
4 keyboard (KEYBOARD)
5 gpio (GPIO)
6 audio (AUDIO)
7 sha2 (SHA2)
8 sha512 (SHA512)
9 engine (ENGINE)

## Further device data
memoryRegions:
  ROM baseAddress=0x00000000 size=0x00008000
  SRAM baseAddress=0x10000000 size=0x00020000
  VEXRISCV_DEBUG baseAddress=0xEFFF0000 size=0x00000100
  SRAM_EXT baseAddress=0x40000000 size=0x01000000
  MEMLCD baseAddress=0xB0000000 size=0x00005C20
  SPIFLASH baseAddress=0x20000000 size=0x08000000
  AUDIO baseAddress=0xE0000000 size=0x00000004
  SHA2 baseAddress=0xE0001000 size=0x00000004
  SHA512 baseAddress=0xE0002000 size=0x00000008
  ENGINE baseAddress=0xE0020000 size=0x00020000
  CSR baseAddress=0xF0000000 size=0x00040000

## CTRL
Base 0xF0000000
0x00 RESET — Write a ``1`` to this register to reset the SoC.
  [0] reset
0x04 SCRATCH reset 0x12345678 — Use this register as a scratch space to verify that software read/write accesses to the Wishbone/CSR bus are working correctly. The initial reset value of 0x1234578 can be used to verify endianness.
0x08 BUS_ERRORS ro — Total number of Wishbone bus errors (timeouts) since start.

## IDENTIFIER_MEM
Base 0xF0002000
0x00 IDENTIFIER_MEM — 8 x 28-bit memory
  [7:0] identifier_mem

## UART_PHY
Base 0xF0003000
0x00 TUNING_WORD reset 0x4B7F5A

## UART
Base 0xF0004000
0x00 RXTX
  [7:0] rxtx
0x04 TXFULL ro
  [0] txfull
0x08 RXEMPTY ro
  [0] rxempty
0x0C EV_STATUS
  [1:0] status
0x10 EV_PENDING
  [1:0] pending
0x14 EV_ENABLE
  [1:0] enable
0x18 TXEMPTY ro
  [0] txempty
0x1C RXFULL ro
  [0] rxfull

## TIMER0
Base 0xF0005000
0x00 LOAD — Load value when Timer is (re-)enabled. In One-Shot mode, the value written to this register specifies the Timer's duration in clock cycles.
0x04 RELOAD — Reload value when Timer reaches ``0``. In Periodic mode, the value written to this register specify the Timer's period in clock cycles.
0x08 EN — Enable flag of the Timer. Set this flag to ``1`` to enable/start the Timer. Set to ``0`` to disable the Timer.
  [0] en
0x0C UPDATE_VALUE — Update trigger for the current countdown value. A write to this register latches the current countdown value to ``value`` register.
  [0] update_value
0x10 VALUE ro — Latched countdown value. This value is updated by writing to ``update_value``.
0x14 EV_STATUS
  [0] status
0x18 EV_PENDING
  [0] pending
0x1C EV_ENABLE
  [0] enable

## REBOOT
Base 0xF0006000
0x00 CTRL
  [7:0] ctrl
0x04 ADDR

## CRG
Base 0xF0007000
0x00 MMCM_DRP_RESET
  [0] mmcm_drp_reset
0x04 MMCM_DRP_LOCKED ro
  [0] mmcm_drp_locked
0x08 MMCM_DRP_READ
  [0] mmcm_drp_read
0x0C MMCM_DRP_WRITE
  [0] mmcm_drp_write
0x10 MMCM_DRP_DRDY ro
  [0] mmcm_drp_drdy
0x14 MMCM_DRP_ADR
  [6:0] mmcm_drp_adr
0x18 MMCM_DRP_DAT_W
  [15:0] mmcm_drp_dat_w
0x1C MMCM_DRP_DAT_R ro
  [15:0] mmcm_drp_dat_r
